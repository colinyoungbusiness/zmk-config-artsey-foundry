/ {
    kscan: kscan {
        compatible = "zmk,kscan-gpio-direct";

        input-gpios = <
            &gpio0 2 (GPIO_PULL_UP | GPIO_ACTIVE_LOW)
            &gpio0 3 (GPIO_PULL_UP | GPIO_ACTIVE_LOW)
            &gpio0 28 (GPIO_PULL_UP | GPIO_ACTIVE_LOW)
            &gpio0 29 (GPIO_PULL_UP | GPIO_ACTIVE_LOW)

            &gpio0 4 (GPIO_PULL_UP | GPIO_ACTIVE_LOW)
            &gpio1 15 (GPIO_PULL_UP | GPIO_ACTIVE_LOW)
            &gpio1 14 (GPIO_PULL_UP | GPIO_ACTIVE_LOW)
            &gpio1 13 (GPIO_PULL_UP | GPIO_ACTIVE_LOW)
        >;
    };
};